## layers/meta-clockos/conf/layer.conf
```bitbake
# We have a conf and classes directory, add to BBPATH
BBPATH .= ":${LAYERDIR}"

# We have recipes-* directories, add to BBFILES
BBFILES += "${LAYERDIR}/recipes-*/*/*.bb \
            ${LAYERDIR}/recipes-*/*/*.bbappend"

BBFILE_COLLECTIONS += "meta-clockos"
BBFILE_PATTERN_meta-clockos = "^${LAYERDIR}/"
BBFILE_PRIORITY_meta-clockos = "10"

LAYERDEPENDS_meta-clockos = "core"
LAYERSERIES_COMPAT_meta-clockos = "styhead"

MACHINE ??= "raspberrypi5"

VIDEO_CAMERA = "1"
ENABLE_SPI_BUS = "1"
ENABLE_I2C = "1"
LICENSE_FLAGS_ACCEPTED:append = " synaptics-killswitch"

RPI_EXTRA_CONFIG:append = " \n \
dtoverlay=imx219,cam0 \n \
dtparam=i2c_vc=on \n \
dtoverlay=pwm-2chan,pin2=13,func2=4 \n \
"
RPI_EXTRA_CONFIG:append:raspberrypi5 = "\n# ClockOS ST7735R Display\ndtoverlay=adafruit-st7735r,speed=32000000,rotate=90,dc_pin=24,reset_pin=25,led_pin=18\n"

DISTRO_FEATURES:append = " systemd wifi bluetooth usrmerge opengl"
VIRTUAL-RUNTIME_init_manager = "systemd"
VIRTUAL-RUNTIME_dev_manager  = "udev"
KERNEL_DEVICETREE:append:raspberrypi5 = " overlays/adafruit-st7735r.dtbo"
KERNEL_MODULE_AUTOLOAD:append = " i2c-dev imx219 rp1-cfe buzzer_drv"
INSANE_SKIP:pn-libpisp += "buildpaths"
```
